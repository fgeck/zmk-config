## config/west.yml
```yaml
manifest:
  remotes:
    - name: zmkfirmware
      url-base: https://github.com/zmkfirmware
    - name: carrefinho
      url-base: https://github.com/carrefinho
    - name: maatthc
      url-base: https://github.com/maatthc
    - name: anywhy-io
      url-base: https://github.com/anywhy-io
    - name: fgeck
      url-base: https://github.com/fgeck
    - name: zzeneg # <-- required for Raw HID module
      url-base: https://github.com/zzeneg
    - name: srwi # <-- required for KeyPeek module
      url-base: https://github.com/srwi
  projects:
    - name: zmk
      remote: zmkfirmware
      revision: main
      import: app/west.yml
    - name: flake-zmk-module
      remote: anywhy-io
      revision: main
      path: modules/flake-zmk-module
    - name: prospector-zmk-module
      remote: carrefinho
      revision: feat/new-status-screens
      path: modules/prospector-zmk-module
    - name: zmk-feature-appcompanion
      remote: fgeck
      revision: main
    - name: zmk-raw-hid # <-- Raw HID module
      remote: zzeneg
      revision: main
    - name: zmk-keypeek-layer-notifier # <-- KeyPeek module
      remote: srwi
      revision: master
  self:
    path: config
```
