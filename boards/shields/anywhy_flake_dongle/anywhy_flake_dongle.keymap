/*
 * Copyright (c) 2024 The ZMK Contributors
 * SPDX-License-Identifier: MIT
 */

#include <behaviors.dtsi>
#include <dt-bindings/zmk/keys.h>

/ {
    keymap {
        compatible = "zmk,keymap";

        default_layer {
            // Dongle has no physical keys - this is a placeholder
            // The actual keypresses come from the wireless peripherals (left/right halves)
            bindings = <>;
        };
    };
};
